## main/Kconfig.projbuild
```kconfig
menu "ESPFanManager Configuration"
    config ESPFM_WIFI_SSID
        string "WiFi SSID"
        default "myssid"
    config ESPFM_WIFI_PASSWORD
        string "WiFi Password"
        default "mypassword"
    config ESPFM_AP_PASSWORD
        string "WiFi AP password (min 8 chars for WPA2)"
        default "espfm123"
    config ESPFM_WIFI_MAX_RETRY
        int "Maximum WiFi retry attempts"
        default 5
        range 1 20
    config ESPFM_OVERTEMP_THRESHOLD_C
        int "Over-temperature alarm threshold (deg C)"
        default 85
        range 50 150
    config ESPFM_CONTROL_PERIOD_MS
        int "Control loop period (ms)"
        default 1000
        range 100 10000
endmenu
```

## sdkconfig.defaults
```kconfig
CONFIG_PARTITION_TABLE_CUSTOM=y
CONFIG_PARTITION_TABLE_CUSTOM_FILENAME="partitions.csv"
CONFIG_PARTITION_TABLE_FILENAME="partitions.csv"
CONFIG_ESP_MAIN_TASK_STACK_SIZE=8192
CONFIG_MBEDTLS_SSL_PROTO_DTLS=y
CONFIG_MBEDTLS_KEY_EXCHANGE_ECDHE_ECDSA=y
CONFIG_MBEDTLS_KEY_EXCHANGE_ECDHE_RSA=y
CONFIG_MBEDTLS_KEY_EXCHANGE_DHE_RSA=y
CONFIG_MBEDTLS_ECP_DP_SECP256R1_ENABLED=y
```

## sdkconfig.defaults.esp32
```kconfig
CONFIG_IDF_TARGET="esp32"

# WROOM
# CONFIG_ESPTOOLPY_FLASHSIZE_4MB=y
# CONFIG_ESPTOOLPY_FLASHSIZE="4MB"

# WROVER
CONFIG_ESPTOOLPY_FLASHSIZE_16MB=y
CONFIG_ESPTOOLPY_FLASHSIZE="16MB"
```
